## dts/bindings/behaviours/zmk,behavior-input-one-shot-two-axis.yaml
```yaml
description: One-shot 2-axis relative input (tap generates single report)

compatible: "zmk,behavior-input-one-shot-two-axis"

include: one_param.yaml

properties:
  x-input-code:
    type: int
    required: true
    description: "Zephyr input relative code for X axis (e.g. INPUT_REL_HWHEEL)."

  y-input-code:
    type: int
    required: true
    description: "Zephyr input relative code for Y axis (e.g. INPUT_REL_WHEEL)."

  scale:
    type: int
    required: false
    default: 1
    description: "Multiplier applied to MOVE_X/Y_DECODE(param1)."

  "#binding-cells":
    const: 1
```

## dts/bindings/behaviours/zmk,behavior-input-two-axis-oneshot.yaml
```yaml
description: Two axis input behavior with optional one-shot emit on press (tap-friendly)

compatible: "zmk,behavior-input-two-axis-oneshot"

include: one_param.yaml

properties:
  x-input-code:
    type: int
    required: true

  y-input-code:
    type: int
    required: true

  trigger-period-ms:
    type: int
    required: true

  delay-ms:
    type: int
    required: false
    default: 0

  time-to-max-speed-ms:
    type: int
    required: true

  acceleration-exponent:
    type: int
    required: false
    default: 1

  oneshot-on-press:
    type: boolean
    required: false
    default: true
    description: "Emit one relative report immediately on press."

  oneshot-scale:
    type: int
    required: false
    default: 120
    description: "Multiplier applied to MOVE_X/Y_DECODE(param1) for oneshot emission."

  disable-continuous:
    type: boolean
    required: false
    default: true
    description: "If true, do not start tick-based continuous movement."

  "#binding-cells":
    const: 1
```

## dts/bindings/behaviours/zmk,behavior-mouse-move-dynamic.yaml
```yaml
description: Mouse move behavior that derives speed dynamically from a shared value store

compatible: "zmk,behavior-mouse-move-dynamic"

include: base.yaml

properties:
  "#binding-cells":
    type: int
    required: true
    const: 1

  binding:
    type: phandle
    required: true
    description: Target behavior to invoke (usually &mmv)

  index:
    type: int
    required: false
    default: 0
    description: Value-store index to read speed from

  value-min:
    type: int
    required: false
    default: 0

  value-max:
    type: int
    required: false
    default: 100

  min-vel:
    type: int
    required: false
    default: 200

  max-vel:
    type: int
    required: false
    default: 1800

  poll-ms:
    type: int
    required: false
    default: 40
```

## dts/bindings/behaviours/zmk,behavior-mouse-move-fixed.yaml
```yaml
description: Debug mouse move behavior (fixed speed, direct input_report_rel)

compatible: "zmk,behavior-mouse-move-fixed"

include: one_param.yaml

properties:
  "#binding-cells":
    type: int
    required: true
    const: 1

  speed:
    type: int
    required: false
    default: 1200
    description: Movement speed (units/sec)

  trigger-period-ms:
    type: int
    required: false
    default: 20
    description: Tick interval in ms
```

## dts/bindings/behaviours/zmk,behavior-mouse-move-value.yaml
```yaml
description: Mouse move behavior with dynamic speed from value_store

compatible: "zmk,behavior-mouse-move-value"


include: one_param.yaml

properties:
  binding:
    type: phandle
    required: true
    description: Target mmv behavior device to control

  index:
    type: int
    required: false
    default: 0

  value-min:
    type: int
    required: false
    default: 0

  value-max:
    type: int
    required: false
    default: 100

  min-speed:
    type: int
    required: false
    default: 200

  max-speed:
    type: int
    required: false
    default: 1800

  trigger-period-ms:
    type: int
    required: false
    default: 40

  normalize-diagonal:
    type: boolean
    required: false
    default: true

  diag-scale-permil:
    type: int
    required: false
    default: 707
    description: "Scale applied to X/Y when moving diagonally. 707 ~= 1/sqrt(2) * 1000"
```

## dts/bindings/behaviours/zmk,behavior-sensor-rotate-accel.yaml
```yaml
description: Sensor rotate behavior with acceleration (dt-based step scaling)

compatible: "zmk,behavior-sensor-rotate-accel"

properties:
  "#sensor-binding-cells":
    const: 0

  bindings:
    type: phandles
    required: true

  dt-min-ms:
    type: int
    default: 30
    description: "dt <= dt-min-ms is treated as max speed"

  dt-max-ms:
    type: int
    default: 200
    description: "dt >= dt-max-ms is treated as min speed"

  steps-min:
    type: int
    default: 1

  steps-max:
    type: int
    default: 5

  curve:
    type: int
    default: 1
    description: "0=linear, 1=quadratic(ease-out), 2=cubic(ease-out)"

  same-dir-only:
    type: boolean
    description: "If set, direction change resets acceleration (treated as slow)"

  tap-ms:
    type: int
    default: 0
    description: "Delay between press and release enqueued for the binding"
```

## dts/bindings/behaviours/zmk,behavior-sensor-value-adjust.yaml
```yaml
description: Sensor behavior to adjust an integer value by rotary detents

compatible: "zmk,behavior-sensor-value-adjust"

properties:
  "#sensor-binding-cells":
    type: int
    required: true
    const: 0
  
  # ★keymap sensor controllerとして成立させるため（中身は使わないのでダミーでOK）
  bindings:
    type: phandle-array
    required: true
    description: "Dummy binding list. Use <&none>."

  index:
    type: int
    required: true

  min:
    type: int
    required: false
    default: 0

  max:
    type: int
    required: false
    default: 100

  step:
    type: int
    required: false
    default: 1

  ticks-per-step:
    type: int
    required: false
    default: 1

  continuous:
    type: boolean
    required: false
```

## dts/bindings/behaviours/zmk,behavior-value-set.yaml
```yaml
description: Set a value_store slot to a fixed value on key press

compatible: "zmk,behavior-value-set"

include: zero_param.yaml

properties:
  index:
    type: int
    required: true

  value:
    type: int
    required: true
```

## dts/bindings/behaviours/zmk,behavior-value-switch.yaml
```yaml
description: Dispatch to a binding based on value_store value

compatible: "zmk,behavior-value-switch"

include: zero_param.yaml

properties:
  index:
    type: int
    required: true

  fallback:
    type: int
    required: false
    default: 0

  case-values:
    type: array
    required: true
    description: Integer values to match against value_store[index]

  bindings:
    type: phandle-array
    required: true
    description: Binding list aligned by index with case-values

  default-binding:
    type: phandle-array
    required: false
    description: Optional binding used when no case value matches
```
